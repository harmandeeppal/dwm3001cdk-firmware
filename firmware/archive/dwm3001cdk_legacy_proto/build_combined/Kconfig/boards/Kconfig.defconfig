## firmware/archive/dwm3001cdk_legacy_proto/build_combined/Kconfig/boards/Kconfig.defconfig
```kconfig
# Load Zephyr board defconfig descriptions.
osource "C:/ncs/v3.4.0/zephyr/boards/nordic/nrf52833dk/Kconfig.defconfig"
```

## outputs/builds/dwm3001cdk_dw3110_probe_DWM-01/Kconfig/boards/Kconfig.defconfig
```kconfig
# Load Zephyr board defconfig descriptions.
osource "C:/ncs/v3.4.0/zephyr/boards/qorvo/decawave_dwm3001cdk/Kconfig.defconfig"
```

## outputs/builds/dwm3001cdk_dw3110_probe_DWM-01_led_v2/Kconfig/boards/Kconfig.decawave_dwm3001cdk
```kconfig
# Load board Kconfig descriptions.
osource "C:/ncs/v3.4.0/zephyr/boards/qorvo/decawave_dwm3001cdk/Kconfig.decawave_dwm3001cdk"
```
